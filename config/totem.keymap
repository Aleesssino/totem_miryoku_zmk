#define MIRYOKU_LAYERS_FLIPPED

#define MIRYOKU_LAYOUT_MAPPING( \
    K00, K01, K02, K03, K04,      K05, K06, K07, K08, K09, \
    K10, K11, K12, K13, K14,      K15, K16, K17, K18, K19, \
    K20, K21, K22, K23, K24,      K25, K26, K27, K28, K29, \
    N30, N31, K32, K33, K34,      K35, K36, K37, N38, N39 \
) \
&kp TAB  K00  K01  K02  K03  K04    K05  K06  K07  K08  K09  &kp BSPC \
&kp ESC  K10  K11  K12  K13  K14    K15  K16  K17  K18  K19  &kp DEL \
&kp LALT K20  K21  K22  K23  K24    K25  K26  K27  K28  K29  &kp RALT \
              K32  K33  K34    K35  K36  K37

#include "../miryoku/custom_config.h"
#include "../miryoku/miryoku.dtsi"
